## firmware/esp8266/wifi_http_demo/main/Kconfig.projbuild
```kconfig
menu "WiFi MQTT Demo Network Configuration"
    config WIFI_HTTP_DEMO_STATIC_IP
        string "Static STA IPv4 address"
        default "192.168.2.100"
        help
            Fixed IPv4 address used by the ESP8266 station interface.

    config WIFI_HTTP_DEMO_STATIC_NETMASK
        string "Static STA netmask"
        default "255.255.255.0"
        help
            Netmask used together with the fixed station IPv4 address.

    config WIFI_HTTP_DEMO_STATIC_GATEWAY
        string "Static STA gateway"
        default "192.168.2.1"
        help
            Default gateway used by the fixed station IPv4 address.

    config WIFI_HTTP_DEMO_STATIC_DNS_MAIN
        string "Static STA primary DNS"
        default "192.168.2.1"
        help
            Primary DNS server used when DHCP is disabled.

    config WIFI_HTTP_DEMO_STATIC_DNS_BACKUP
        string "Static STA backup DNS"
        default "8.8.8.8"
        help
            Backup DNS server used when DHCP is disabled.
endmenu

menu "WiFi MQTT Demo Device Output Configuration"
    config WIFI_HTTP_DEMO_DEVICE_GPIO
        int "Device output GPIO"
        range 0 16
        default 5
        help
            GPIO used to control the real device output.
            For ESP8266 NodeMCU boards, D1 maps to GPIO5 and is a good general-purpose output
            because it is not one of the boot strap pins.

    config WIFI_HTTP_DEMO_DEVICE_ACTIVE_LOW
        bool "Device output is active low"
        default n
        help
            Enable this if your relay or driver turns on when the GPIO output is low.

    config WIFI_HTTP_DEMO_INDICATOR_LED_GPIO
        int "Indicator LED GPIO"
        range 0 16
        default 2
        help
            GPIO used for the visual indicator LED.
            Many ESP8266 NodeMCU boards use GPIO2 for the onboard LED.

    config WIFI_HTTP_DEMO_INDICATOR_LED_ACTIVE_LOW
        bool "Indicator LED is active low"
        default y
        help
            Enable this if the indicator LED turns on when the GPIO output is low.
endmenu

menu "WiFi MQTT Demo MQTT Configuration"
    config WIFI_HTTP_DEMO_MQTT_URI
        string "MQTT broker URI"
        default "mqtts://your-emqx-host:8883"
        help
            Full MQTT URI used by the ESP8266 MQTT client.

    config WIFI_HTTP_DEMO_MQTT_USERNAME
        string "MQTT username"
        default "your-mqtt-username"
        help
            Username used when connecting to the MQTT broker.

    config WIFI_HTTP_DEMO_MQTT_PASSWORD
        string "MQTT password"
        default "your-mqtt-password"
        help
            Password used when connecting to the MQTT broker.

    config WIFI_HTTP_DEMO_MQTT_TOPIC_ROOT
        string "MQTT topic root"
        default "nodemcu"
        help
            Base topic prefix used to derive the command and status topics.

    config WIFI_HTTP_DEMO_MQTT_CLIENT_ID_PREFIX
        string "MQTT client ID prefix"
        default "esp8266-nodemcu"
        help
            A MAC-derived suffix is appended automatically to keep the client ID unique.
endmenu
```

## firmware/esp8266/wifi_http_demo/sdkconfig.defaults
```kconfig
# Quick Edit: Wi-Fi + MQTT
CONFIG_EXAMPLE_WIFI_SSID="your-wifi-ssid"
CONFIG_EXAMPLE_WIFI_PASSWORD="your-wifi-password"
CONFIG_WIFI_HTTP_DEMO_STATIC_IP="192.168.2.100"
CONFIG_WIFI_HTTP_DEMO_STATIC_NETMASK="255.255.255.0"
CONFIG_WIFI_HTTP_DEMO_STATIC_GATEWAY="192.168.2.1"
CONFIG_WIFI_HTTP_DEMO_STATIC_DNS_MAIN="192.168.2.1"
CONFIG_WIFI_HTTP_DEMO_STATIC_DNS_BACKUP="8.8.8.8"
CONFIG_WIFI_HTTP_DEMO_LED_GPIO=2
CONFIG_WIFI_HTTP_DEMO_LED_ACTIVE_LOW=y
CONFIG_WIFI_HTTP_DEMO_MQTT_URI="mqtts://your-emqx-host:8883"
CONFIG_WIFI_HTTP_DEMO_MQTT_USERNAME="your-mqtt-username"
CONFIG_WIFI_HTTP_DEMO_MQTT_PASSWORD="your-mqtt-password"
CONFIG_WIFI_HTTP_DEMO_MQTT_TOPIC_ROOT="nodemcu"
CONFIG_WIFI_HTTP_DEMO_MQTT_CLIENT_ID_PREFIX="esp8266-nodemcu"

# Set the serial port locally in menuconfig, for example COM3 on Windows.
# CONFIG_ESPTOOLPY_FLASHMODE_QIO is not set
CONFIG_ESPTOOLPY_FLASHMODE_DIO=y
CONFIG_ESPTOOLPY_FLASHMODE="dio"
CONFIG_SPI_FLASH_MODE=0x2
```
